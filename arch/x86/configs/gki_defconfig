## drivers/trusty/Kconfig
```kconfig
#
# Trusty
#

menu "Trusty"

config TRUSTY
	tristate "Trusty"
	depends on ARM || ARM64

if TRUSTY

config TRUSTY_IRQ
	tristate "Trusty IRQ support"

config TRUSTY_LOG
	tristate "Trusty log support"

config TRUSTY_TEST
	tristate "Trusty stdcall test"
	help
	  Allow running tests of trusty stdcall interface.

	  Need test service on trusty side.
	  Say N if you don't have the matching trusty side test service.

config TRUSTY_VIRTIO
	tristate "Trusty virtio support"
	select VIRTIO

config TRUSTY_VIRTIO_IPC
	tristate "Trusty Virtio IPC driver"
	depends on TRUSTY_VIRTIO
	help
	  This module adds support for communications with Trusty Services

	  If you choose to build a module, it'll be called trusty-ipc.
	  Say N if unsure.

endif # TRUSTY

endmenu
```

## drivers/virt/gunyah/Kconfig
```kconfig
# SPDX-License-Identifier: GPL-2.0-only

config GUNYAH
	tristate "Gunyah Virtualization drivers"
	depends on ARM64
	depends on MAILBOX
	select GUNYAH_PLATFORM_HOOKS
	select AUXILIARY_BUS
	imply GUNYAH_QCOM_PLATFORM if ARCH_QCOM
	help
	  The Gunyah drivers are the helper interfaces that run in a guest VM
	  such as basic inter-VM IPC and signaling mechanisms, and higher level
	  services such as memory/device sharing, IRQ sharing, and so on.

	  Say Y/M here to enable the drivers needed to interact in a Gunyah
	  virtual environment.

config GUNYAH_PLATFORM_HOOKS
	tristate

config GUNYAH_QCOM_PLATFORM
	tristate "Support for Gunyah on Qualcomm platforms"
	depends on GUNYAH
	select GUNYAH_PLATFORM_HOOKS
	select QCOM_SCM
	help
	  Enable support for interacting with Gunyah on Qualcomm
	  platforms. Interaction with Qualcomm firmware requires
	  extra platform-specific support.

	  Say Y/M here to use Gunyah on Qualcomm platforms.

config GUNYAH_VCPU
	tristate "Runnable Gunyah vCPUs"
	depends on GUNYAH
	help
	  Enable kernel support for host-scheduled vCPUs running under Gunyah.
	  When selecting this option, userspace virtual machine managers (VMM)
	  can schedule the guest VM's vCPUs instead of using Gunyah's scheduler.
	  VMMs can also handle stage 2 faults of the vCPUs.

	  Say Y/M here if unsure and you want to support Gunyah VMMs.

config GUNYAH_IRQFD
	tristate "Gunyah irqfd interface"
	depends on GUNYAH
	help
	  Enable kernel support for creating irqfds which can raise an interrupt
	  on Gunyah virtual machine.

	  Say Y/M here if unsure and you want to support Gunyah VMMs.

config GUNYAH_IOEVENTFD
	tristate "Gunyah ioeventfd interface"
	depends on GUNYAH
	help
	  Enable kernel support for creating ioeventfds which can alert userspace
	  when a Gunyah virtual machine accesses a memory address.

	  Say Y/M here if unsure and you want to support Gunyah VMMs.

menuconfig GUNYAH_DRIVERS
	bool "Gunyah Vendor Virtualization drivers"
	depends on ARM64
	depends on GUNYAH
	help
	  The Gunyah drivers are the helper interfaces that runs on the
	  virtual machines that provides support such as memory/device
	  sharing, IRQ sharing, IPC/signalling mechanisms, and so on.

	  Say Y here to enable the drivers needed to work on Gunyah
	  virtualization environment.

	  If you say N, all options in this submenu will be skipped and disabled.

if GUNYAH_DRIVERS

config GH_DBL
	tristate "Gunyah Doorbell driver"
	help
	  Gunyah offers a simple inter VMs(Virtual Machines) communication
	  through the use of doorbell interrupts. A single doorbell instance
	  provides an unidirectional communication between two VMs and it acts
	  like either a source(Tx) or generate(Rx). Individual VMs make use of
	  these doorbells by calling send and/or a receive primitives exposed by
	  driver and trigger an interrupt to each other and exchange the data.

config GH_MSGQ
	tristate "Gunyah Message Queue driver"
	help
	  Gunyah offers message-queues as one of the IPC mechanisms to
	  communicate among the Virtual Machines. The message queue drivers
	  runs on the Virtual machines to provide an interface to the clients
	  who wish to communicate to other clients on a different VM. Currently,
	  the services offered by the drivers is simply to send and receive
	  messages in a blocking manner.

config GH_RM_DRV
	tristate "Gunyah Resource Manager driver"
	help
	  The Gunyah Resource Manager driver is used to communicate with the
	  Resource Manager Virtual Machine (RM-VM). The RM-VM acts as a mediator
	  and provides numerous services to the other VMs running in the system,
	  such as notifying when a particular VM is up, resource (IRQ/device)
	  sharing between VMs, information about the IPC mechanisms, and so on.

	  The Resource Manager driver runs on the Virtual Machine and acts as an
	  interface to other driver in order to obtain the services provided by
	  the RM-VM.

endif
```
